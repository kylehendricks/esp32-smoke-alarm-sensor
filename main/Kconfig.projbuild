## main/Kconfig.projbuild
```kconfig
menu "WIFI Configuration"

config WIFI_SSID
    string "WiFi SSID"
    help
        SSID (network name) for the example to connect to.

config WIFI_PASSWORD
    string "WiFi Password"
    help
        WiFi password (WPA or WPA2) for the example to use.

config PIN_WIFI_STATUS_LED
    int "GPIO pin for WiFi status LED"
    range 0 34
    help
        The pin used to connect to a WiFi status LED

endmenu

menu "MQTT Configuration"

config MQTT_HOST
    string "MQTT Host"
    help
        MQTT hostname

config MQTT_PORT
    int "MQTT Port"
    default 1883
    help
        MQTT port (default 1883 unencrypted, 8883 encrypted)

config MQTT_USERNAME
    string "MQTT username"
    default ""
    help
        MQTT username

config MQTT_PASSWORD
    string "MQTT Password"
    default ""
    help
        MQTT password

config MQTT_LWT_TOPIC
    string "MQTT Last Will Topic"
    help
        Topic to use when sending the MQTT "Last Will"

endmenu

menu "Sensor Configuration"

config PIN_SMOKE_ALARM_RELAY
    int "GPIO pin for smoke alarm"
    range 0 34
    help
        The pin that is connected to the smoke alarm relay

config SMOKE_ALARM_PIN_READ_INTERVAL_MS
    int "Smoke alarm pin read interval"
    default 100
    help
        The interval at which the the status of the smoke alarm relay pin is read

config MQTT_ALARM_TOPIC
    string "MQTT Alarm Topic"
    help
        Topic to use when publishing an alarm

endmenu
```
